## config/boards/shields/dimetrodon/Kconfig.defconfig
```kconfig
# Copyright (c) 2022 The ZMK Contributors
# SPDX-License-Identifier: MIT

if SHIELD_DIMETRODON_LEFT

config ZMK_KEYBOARD_NAME
	default "Dimetrodon"

config ZMK_SPLIT_BLE_ROLE_CENTRAL
	default y

endif

if SHIELD_DIMETRODON_LEFT || SHIELD_DIMETRODON_RIGHT

config ZMK_SPLIT
	default y

endif
```

## config/boards/shields/dimetrodon/Kconfig.shield
```kconfig
# Copyright (c) 2022 The ZMK Contributors
# SPDX-License-Identifier: MIT

config SHIELD_DIMETRODON_LEFT
	def_bool $(shields_list_contains,dimetrodon_left)

config SHIELD_DIMETRODON_RIGHT
	def_bool $(shields_list_contains,dimetrodon_right)
```

## config/west.yml
```yaml
manifest:
  remotes:
    - name: zmkfirmware
      url-base: https://github.com/zmkfirmware
    - name: urob
      url-base: https://github.com/urob
  projects:
    - name: zmk
      remote: zmkfirmware
      revision: 27afcb11efff6345d0ceb875e85c2de0673123f6 # main snapshot (2026-02-28)
      import: app/west.yml
    - name: zmk-helpers
      remote: urob
      revision: e1d928de136b00e069a41129885d56e5a79e5c1e # main snapshot (2026-02-28)
  self:
    path: config
```
